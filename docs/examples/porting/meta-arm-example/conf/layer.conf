## docs/examples/porting/meta-arm-example/conf/layer.conf
```bitbake
# ARM Platform Example Layer Configuration
# Reference: NVIDIA OpenBMC meta-nvidia/conf/layer.conf
# https://github.com/NVIDIA/openbmc/blob/develop/meta-nvidia/conf/layer.conf

# Layer path
BBPATH .= ":${LAYERDIR}"

# Recipe locations
BBFILES += "${LAYERDIR}/recipes-*/*/*.bb"
BBFILES += "${LAYERDIR}/recipes-*/*/*.bbappend"

# Layer metadata
BBFILE_COLLECTIONS += "meta-arm-example"
BBFILE_PATTERN_meta-arm-example = "^${LAYERDIR}/"

# Layer priority (higher overrides lower)
# Platform layers typically use 10-20
BBFILE_PRIORITY_meta-arm-example = "10"

# Compatible Yocto releases
# Update this for your target OpenBMC version
LAYERSERIES_COMPAT_meta-arm-example = "whinlatter walnascar"

# Layer dependencies
# Requires meta-arm for ARM architecture support
LAYERDEPENDS_meta-arm-example = "meta-arm"

# Optional: Add meta-arm-bsp for reference platform support
# LAYERDEPENDS_meta-arm-example += "meta-arm-bsp"

# Machine configuration path
MACHINEOVERRIDES =. "arm-example:"
```

## docs/examples/porting/meta-arm-example/conf/machine/arm-example-bmc.conf
```bitbake
#@TYPE: Machine
#@NAME: ARM Example BMC Platform
#@DESCRIPTION: Example OpenBMC machine configuration for ARM-based servers
#
# Reference: NVIDIA GB200 NVL BMC configuration
# https://github.com/NVIDIA/openbmc/blob/develop/meta-nvidia/meta-prime/meta-graceblackwell/meta-gb200nvl/meta-bmc/conf/machine/gb200nvl-bmc.conf

# ==============================================================================
# CPU Architecture
# ==============================================================================

# ARM64 (AArch64) configuration
# Options: cortexa53, cortexa57, cortexa72, cortexa76
DEFAULTTUNE = "cortexa53"
require conf/machine/include/arm/armv8a/tune-cortexa53.inc

# Alternative: ARM32 (uncomment if needed)
# DEFAULTTUNE = "cortexa9thf-neon"
# require conf/machine/include/arm/armv7a/tune-cortexa9.inc

# ==============================================================================
# Kernel Configuration
# ==============================================================================

# Kernel provider
PREFERRED_PROVIDER_virtual/kernel = "linux-yocto"

# Kernel image type
# ARM64: "Image", ARM32: "zImage"
KERNEL_IMAGETYPE = "Image"

# Device tree blob
KERNEL_DEVICETREE = "arm-example-bmc.dtb"

# Optional: Additional kernel modules
MACHINE_ESSENTIAL_EXTRA_RRECOMMENDS += "kernel-modules"

# ==============================================================================
# Bootloader Configuration
# ==============================================================================

# U-Boot provider
PREFERRED_PROVIDER_virtual/bootloader = "u-boot"
PREFERRED_PROVIDER_u-boot = "u-boot"

# U-Boot machine configuration
# Create corresponding defconfig in recipes-bsp/u-boot/
UBOOT_MACHINE = "arm_example_bmc_defconfig"

# For ARM platforms with TF-A:
# SPL_BINARY = "spl/u-boot-spl.bin"

# ==============================================================================
# Flash Layout
# ==============================================================================

# Total flash size in KB (64MB)
FLASH_SIZE = "65536"

# Partition offsets (in KB)
FLASH_UBOOT_OFFSET = "0"
FLASH_UBOOT_ENV_OFFSET = "896"
FLASH_KERNEL_OFFSET = "1024"
FLASH_ROFS_OFFSET = "10240"
FLASH_RWFS_OFFSET = "49152"

# ==============================================================================
# Console Configuration
# ==============================================================================

# Serial console device and baud rate
# ARM PL011 UART: ttyAMA0
# ASPEED UART: ttyS0-ttyS4
SERIAL_CONSOLES = "115200;ttyAMA0"

# ==============================================================================
# Machine Features
# ==============================================================================

# Hardware features
MACHINE_FEATURES = "serial"

# Optional features (uncomment as needed)
# MACHINE_FEATURES += "efi"      # EFI boot support
# MACHINE_FEATURES += "optee"    # OP-TEE support
# MACHINE_FEATURES += "pcbios"   # Legacy BIOS support

# ==============================================================================
# OpenBMC Features
# ==============================================================================

# Core BMC features
OBMC_MACHINE_FEATURES += "\
    obmc-bmc-state-mgmt \
    obmc-chassis-state-mgmt \
    obmc-host-state-mgmt \
    obmc-phosphor-fan-mgmt \
    obmc-phosphor-flash-mgmt \
"

# Optional features (uncomment as needed)
# OBMC_MACHINE_FEATURES += "obmc-phosphor-chassis-mgmt"
# OBMC_MACHINE_FEATURES += "obmc-host-ipmi"

# ==============================================================================
# Inventory Management
# ==============================================================================

# Use Entity Manager for dynamic inventory
VIRTUAL-RUNTIME_obmc-inventory-manager = "entity-manager"

# Alternative: Static inventory (legacy)
# VIRTUAL-RUNTIME_obmc-inventory-manager = "phosphor-inventory-manager"

# ==============================================================================
# Additional Packages
# ==============================================================================

# Extra packages for development
OBMC_IMAGE_EXTRA_INSTALL:append = "\
    i2c-tools \
    devmem2 \
"

# Remove packages not applicable to ARM platforms
# OBMC_IMAGE_EXTRA_INSTALL:remove = "package-name"
```

## docs/examples/porting/meta-myplatform/conf/layer.conf
```bitbake
# Layer configuration for meta-myplatform
# This file defines the layer metadata and dependencies

BBPATH .= ":${LAYERDIR}"

BBFILES += " \
    ${LAYERDIR}/recipes-*/*/*.bb \
    ${LAYERDIR}/recipes-*/*/*.bbappend \
"

BBFILE_COLLECTIONS += "meta-myplatform"
BBFILE_PATTERN_meta-myplatform = "^${LAYERDIR}/"

# Layer priority (higher = takes precedence)
BBFILE_PRIORITY_meta-myplatform = "10"

# Required layer dependencies
LAYERDEPENDS_meta-myplatform = " \
    core \
    meta-phosphor \
    meta-aspeed \
"

# Compatible Yocto releases
LAYERSERIES_COMPAT_meta-myplatform = "kirkstone mickledore scarthgap"
```

## docs/examples/porting/meta-myplatform/conf/machine/myboard.conf
```bitbake
# Machine configuration for MyBoard
# Customize this file for your specific platform

#
# Basic Machine Settings
#
MACHINE_FEATURES += "obmc-phosphor-fan-mgmt"
MACHINE_FEATURES += "obmc-phosphor-chassis-mgmt"
MACHINE_FEATURES += "obmc-host-state-mgmt"

#
# Kernel Configuration
#
KERNEL_DEVICETREE = "aspeed/aspeed-bmc-myplatform-myboard.dtb"

#
# U-Boot Configuration
#
PREFERRED_PROVIDER_virtual/bootloader = "u-boot-aspeed"
PREFERRED_PROVIDER_u-boot = "u-boot-aspeed"
PREFERRED_PROVIDER_u-boot-fw-utils = "u-boot-aspeed-fw-utils"

# SPL boot configuration (for dual boot support)
SPL_BINARY = "spl/u-boot-spl.bin"
UBOOT_SUFFIX = "bin"

#
# Flash Configuration
#
FLASH_SIZE = "32768"  # 32MB BMC flash

#
# Console Settings
#
SERIAL_CONSOLES = "115200;ttyS4"

#
# Distro Features - Enable OpenBMC services
#
DISTRO_FEATURES:append = " obmc-phosphor-fan-mgmt"
DISTRO_FEATURES:append = " obmc-phosphor-chassis-mgmt"
DISTRO_FEATURES:append = " obmc-host-state-mgmt"
DISTRO_FEATURES:append = " obmc-ikvm"
DISTRO_FEATURES:append = " obmc-virtual-media"

#
# Image Install - Machine-specific packages
#
IMAGE_INSTALL:append = " \
    entity-manager \
    dbus-sensors \
    phosphor-led-manager \
    phosphor-fan-control \
    phosphor-pid-control \
    phosphor-state-manager \
    phosphor-power \
    myboard-entity-config \
"

#
# IPMI Configuration
#
# Enable IPMI and configure options
VIRTUAL-RUNTIME_obmc-host-ipmi-hw = "phosphor-ipmi-kcs"

#
# LED Configuration
#
OBMC_LED_MANAGER_INSTANCES = "myboard"

#
# Console Configuration
#
OBMC_CONSOLE_HOST_TTY = "ttyVUART0"

#
# Include common ASPEED configuration
#
require conf/machine/include/aspeed.inc
require conf/machine/include/obmc-bsp-common.inc

#
# Network Configuration
#
# Options: rmii, rgmii, ncsi
OBMC_MACHINE_MAC_INTERFACE = "ncsi"
```
